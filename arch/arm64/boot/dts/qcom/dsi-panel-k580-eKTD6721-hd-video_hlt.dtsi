/* Copyright (c) 2014-2015, 2020, The Linux Foundation. All rights reserved.
 *
 * This program is free software; you can redistribute it and/or modify
 * it under the terms of the GNU General Public License version 2 and
 * only version 2 as published by the Free Software Foundation.
 *
 * This program is distributed in the hope that it will be useful,
 * but WITHOUT ANY WARRANTY; without even the implied warranty of
 * MERCHANTABILITY or FITNESS FOR A PARTICULAR PURPOSE.  See the
 * GNU General Public License for more details.
 */

&mdss_mdp {
	dsi_ektd6721_hd_video: qcom,eKTD6721_k580_hlt_video {
		qcom,mdss-dsi-panel-name =
			"ektd6721 k580 hlt video";
		qcom,mdss-dsi-panel-type = "dsi_video_mode";
		qcom,mdss-dsi-panel-framerate = <60>;
		qcom,mdss-dsi-virtual-channel-id = <0>;
		qcom,mdss-dsi-stream = <0>;
		qcom,mdss-dsi-panel-width = <720>;
		qcom,mdss-dsi-panel-height = <1600>;
		qcom,mdss-dsi-h-front-porch = <64>;
		qcom,mdss-dsi-h-back-porch = <60>;
		qcom,mdss-dsi-h-pulse-width = <20>;
		qcom,mdss-dsi-h-sync-skew = <0>;
		qcom,mdss-dsi-v-back-porch = <10>;
		qcom,mdss-dsi-v-front-porch = <40>;
		qcom,mdss-dsi-v-pulse-width = <1>;
		qcom,mdss-dsi-h-left-border = <0>;
		qcom,mdss-dsi-h-right-border = <0>;
		qcom,mdss-dsi-v-top-border = <0>;
		qcom,mdss-dsi-v-bottom-border = <0>;
		qcom,mdss-pan-physical-width-dimension = <68>;
		qcom,mdss-pan-physical-height-dimension = <151>;
		qcom,mdss-dsi-bpp = <24>;
		qcom,mdss-dsi-color-order = "rgb_swap_rgb";
		qcom,mdss-dsi-underflow-color = <0xff>;
		qcom,mdss-dsi-border-color = <0>;
		/* qcom,mdss-dsi-panel-orientation = "180"; */
		qcom,mdss-dsi-on-command =
			[ 
39 01 00 00 00 00 09 EE 00 04 00 FC 67 50 00 00
39 01 00 00 00 00 05 C2 00 04 00 00
39 01 00 00 00 00 05 BC 00 04 00 00
39 01 00 00 00 00 08 BA 00 04 00 9f 06 1C 3F
39 01 00 00 00 00 1A BA 00 08 00 FF FF FF 0F 06 00 00 13 01 02 19 A4 7C 51 00 00 00 00 00 00 00 00
39 01 00 00 00 00 1C D3 02 04 00 00 00 00 00 00 00 00 C3 C3 C3 E0 C3 C3 EA E9 E8 D1 D9 CC D3 D3 C0 C3 C9
39 01 00 00 00 00 1C D3 02 1C 00 00 00 00 00 00 00 00 C3 C3 C3 E0 C3 C3 EA E9 E8 D0 D6 CC D2 D2 C0 C3 C8
39 01 00 00 00 00 18 D3 00 04 00 00 60 0D 4D 00 00 22 00 23 00 00 22 00 00 00 00 00 00 00 00
39 01 00 00 00 00 2B D3 00 18 00 00 00 10 44 22 2A 07 00 00 41 29 08 00 00 41 22 01 00 00 41 21 02 00 00 41 00 00 20 00 00 20 00 00 00 00 00 00 00 00
39 01 00 00 00 00 31 D3 01 04 00 04 00 0A 2A 00 00 00 00 00 00 00 00 00 00 00 00 00 00 80 09 00 14 53 00 00 00 00 00 00 00 00 00 00 00 00 00 00 00 0F 71 21 00 00 00 00
39 01 00 00 00 00 13 D8 02 04 00 00 00 00 00 00 00 00 00 00 00 00 00 00 00 00
39 01 00 00 00 00 28 D8 01 04 00 00 00 00 00 00 00 00 00 00 00 00 00 00 00 00 00 00 00 00 00 00 00 00 00 00 00 00 00 00 00 00 00 00 00 00 00
39 01 00 00 00 00 0F D8 00 04 00 00 00 00 00 00 00 00 00 00 00 00
39 01 00 00 00 00 10 D8 00 10 00 00 80 AA AA FF AB 00 80 AA AA FF AB
39 01 00 00 00 00 10 D8 00 1C 00 00 80 FA FF FF FF 00 80 FA FF FF FF
39 01 00 00 00 00 10 D8 00 28 00 00 80 9A AA 9A B6 00 80 9A AA 9A B6
39 01 00 00 00 00 10 D8 00 34 00 00 80 FA FF FF FF 00 80 FA FF FF FF
39 01 00 00 00 00 09 B2 00 04 00 00 99 00 35 00
39 01 00 00 00 00 28 B2 01 04 00 0D 41 06 40 6C 00 20 1C 00 20 0A C0 40 0A 35 0C F0 F0 00 00 00 00 00 AC F0 19 00 D0 84 00 00 1B 03 02 00 00
39 01 00 00 00 00 14 B2 01 30 00 00 00 04 00 3D 44 03 B4 D4 00 00 06 C8 02 00 00
39 01 00 00 00 00 08 C0 00 04 00 01 00 00 06
39 01 00 00 00 00 23 C0 00 08 00 00 43 41 16 16 96 16 16 36 00 A0 20 00 20 00 24 04 04 04 A4 64 04 04 80 00 1E 23 00 FF 00 0A
39 01 00 00 00 00 0C C0 01 04 00 8F 10 00 41 7F 00 04 04
39 01 00 00 00 00 14 C0 01 0C 00 22 22 77 22 22 77 11 11 66 00 0C 22 21 33 31 22
39 01 00 00 00 00 08 B1 00 04 00 37 FF 25 00
39 01 00 00 00 00 0C B1 00 08 00 19 18 45 4D 10 18 0A 0C
39 01 00 00 00 00 05 B1 00 10 00 00
39 01 00 00 00 00 07 B1 01 04 00 84 44 30
39 01 00 00 00 00 0D B1 01 08 00 06 AE AE 6C 6C 34 34 FB 43
39 01 00 00 00 00 07 B1 01 14 00 3E 3E 00
39 01 00 00 00 00 08 B1 02 04 00 0F 20 07 0A
39 01 00 00 00 00 06 B1 02 08 00 D8 30
39 01 00 00 00 00 09 B1 02 10 00 45 40 40 00 00
39 01 00 00 00 00 05 CB 00 08 00 13
/*39 01 00 00 00 00 0D B1 01 08 00 06 AE AE 6C 6C B4 B4 F8 40
39 01 00 00 00 00 0A B1 01 18 00 32 15 55 20 00 00
39 01 00 00 00 00 14 C0 01 0C 00 11 11 77 11 11 77 11 11 66 00 3F 00 00 00 00 22
39 01 00 00 00 00 07 B1 01 04 00 9C 44 30
*/
39 01 00 00 00 00 0C B1 00 08 00 19 18 45 4A 11 16 0A 0C
39 01 00 00 00 00 0D B1 01 08 00 06 AE AE 6A 6A 34 34 FB 43
39 01 00 00 00 00 07 C0 00 24 00 FF 00 0F 
39 01 00 00 00 00 30 C1 00 04 00 07 00 28 53 74 90 A7 BC DF EE FC 09 15 21 2C 36 40 49 52 5B 6B 7B 8A 99 A8 B7 C6 D5 E5 F5 06 18 2C 41 58 72 90 B1 DA 0D 51 7F 9B BC
39 01 00 00 00 00 12 C1 00 30 00 E4 FC 00 00 05 55 55 55 55 6A AA AF FF C0
39 01 00 00 00 00 30 C1 01 04 00 00 28 53 74 90 A7 BC DF EE FC 09 15 21 2C 36 40 49 52 5B 6B 7B 8A 99 A8 B7 C6 D5 E5 F5 06 18 2C 41 58 72 90 B1 DA 0D 51 7F 9B BC E4
39 01 00 00 00 00 11 C1 01 30 00 FC 00 00 05 55 55 55 55 6A AA AF FF C0
39 01 00 00 00 00 30 C1 02 04 00 00 28 53 74 90 A7 BC DF EE FC 09 15 21 2C 36 40 49 52 5B 6B 7B 8A 99 A8 B7 C6 D5 E5 F5 06 18 2C 41 58 72 90 B1 DA 0D 51 7F 9B BC E4
39 01 00 00 00 00 11 C1 02 30 00 FC 00 00 05 55 55 55 55 6A AA AF FF C0
39 01 00 00 00 00 30 E3 00 04 00 01 00 28 53 74 90 A7 BC DF EE FC 09 15 21 2C 36 40 49 52 5B 6B 7B 8A 99 A8 B7 C6 D5 E5 F5 06 18 2C 41 58 72 90 B1 DA 0D 51 7F 9B BC
39 01 00 00 00 00 12 E3 00 30 00 E4 FC 00 00 05 55 55 55 55 6A AA AF FF C0
39 01 00 00 00 00 30 E3 01 04 00 00 28 53 74 90 A7 BC DF EE FC 09 15 21 2C 36 40 49 52 5B 6B 7B 8A 99 A8 B7 C6 D5 E5 F5 06 18 2C 41 58 72 90 B1 DA 0D 51 7F 9B BC E4
39 01 00 00 00 00 11 E3 01 30 00 FC 00 00 05 55 55 55 55 6A AA AF FF C0
39 01 00 00 00 00 30 E3 02 04 00 00 28 53 74 90 A7 BC DF EE FC 09 15 21 2C 36 40 49 52 5B 6B 7B 8A 99 A8 B7 C6 D5 E5 F5 06 18 2C 41 58 72 90 B1 DA 0D 51 7F 9B BC E4
39 01 00 00 00 00 11 E3 02 30 00 FC 00 00 05 55 55 55 55 6A AA AF FF C0
39 01 00 00 00 00 09 EE 00 04 00 00 00 00 00 00
39 01 00 00 00 00 02 11 00
39 01 00 00 14 00 02 29 00
];
		qcom,mdss-dsi-off-command = [05 01 00 00 32 00 02 28 00
					05 01 00 00 78 00 02 10 00];
		qcom,mdss-dsi-on-command-state = "dsi_lp_mode";
		qcom,mdss-dsi-off-command-state = "dsi_lp_mode";
		qcom,mdss-dsi-panel-timings-phy-12nm = [08 06 09 02 00 04 02 08];
		qcom,mdss-dsi-h-sync-pulse = <0>;
		qcom,mdss-dsi-traffic-mode = "non_burst_sync_event";
		//qcom,mdss-dsi-traffic-mode = "burst_mode";
		qcom,mdss-dsi-lane-map = "lane_map_0123";
		qcom,mdss-dsi-bllp-eof-power-mode;
		qcom,mdss-dsi-bllp-power-mode;
		qcom,mdss-dsi-tx-eot-append;
		qcom,mdss-dsi-lane-0-state;
		qcom,mdss-dsi-lane-1-state;
		qcom,mdss-dsi-lane-2-state;
		qcom,mdss-dsi-lane-3-state;
		qcom,mdss-dsi-t-clk-post = <0x04>;
		qcom,mdss-dsi-t-clk-pre = <0x1b>;
		qcom,mdss-dsi-dma-trigger = "trigger_sw";
		qcom,mdss-dsi-mdp-trigger = "none";
		qcom,mdss-dsi-lp11-init;
		qcom,mdss-dsi-reset-sequence = <1 20>, <0 30>, <1 50>;
	};
};
