/* Copyright (c) 2014-2015, 2020, The Linux Foundation. All rights reserved.
 *
 * This program is free software; you can redistribute it and/or modify
 * it under the terms of the GNU General Public License version 2 and
 * only version 2 as published by the Free Software Foundation.
 *
 * This program is distributed in the hope that it will be useful,
 * but WITHOUT ANY WARRANTY; without even the implied warranty of
 * MERCHANTABILITY or FITNESS FOR A PARTICULAR PURPOSE.  See the
 * GNU General Public License for more details.
 */

&mdss_mdp {
	dsi_ili9882h_hd_vid: qcom,ili9882h_k580_tcl_video {
		qcom,mdss-dsi-panel-name =
			"ili9882h k580 tcl video";
		qcom,mdss-dsi-panel-type = "dsi_video_mode";
		qcom,mdss-dsi-panel-framerate = <60>;
		qcom,mdss-dsi-virtual-channel-id = <0>;
		qcom,mdss-dsi-stream = <0>;
		qcom,mdss-dsi-panel-width = <720>;
		qcom,mdss-dsi-panel-height = <1600>;
		qcom,mdss-dsi-h-front-porch = <20>;
		qcom,mdss-dsi-h-back-porch = <20>;
		qcom,mdss-dsi-h-pulse-width = <20>;
		qcom,mdss-dsi-h-sync-skew = <0>;
		qcom,mdss-dsi-v-back-porch = <16>;
		qcom,mdss-dsi-v-front-porch = <240>;
		qcom,mdss-dsi-v-pulse-width = <2>;
		qcom,mdss-dsi-h-left-border = <0>;
		qcom,mdss-dsi-h-right-border = <0>;
		qcom,mdss-dsi-v-top-border = <0>;
		qcom,mdss-dsi-v-bottom-border = <0>;
		qcom,mdss-pan-physical-width-dimension = <68>;
		qcom,mdss-pan-physical-height-dimension = <151>;
		qcom,mdss-dsi-bpp = <24>;
		qcom,mdss-dsi-color-order = "rgb_swap_rgb";
		qcom,mdss-dsi-underflow-color = <0xff>;
		qcom,mdss-dsi-border-color = <0>;
		/* qcom,mdss-dsi-panel-orientation = "180"; */
		qcom,mdss-dsi-on-command =
			[ 39 01 00 00 00 00 04 FF 98 82 01 
			  39 01 00 00 00 00 02 00 42 
			  39 01 00 00 00 00 02 01 33 
			  39 01 00 00 00 00 02 02 01 
			  39 01 00 00 00 00 02 03 00 
			  39 01 00 00 00 00 02 04 02 
			  39 01 00 00 00 00 02 05 31 
			  39 01 00 00 00 00 02 07 00 
			  39 01 00 00 00 00 02 08 80 
			  39 01 00 00 00 00 02 09 81 
			  39 01 00 00 00 00 02 0a 71 
			  39 01 00 00 00 00 02 0b 00 
			  39 01 00 00 00 00 02 0c 01 
			  39 01 00 00 00 00 02 0d 01 
			  39 01 00 00 00 00 02 0e 00 
			  39 01 00 00 00 00 02 0f 00 
			  39 01 00 00 00 00 02 28 88 
			  39 01 00 00 00 00 02 29 88 
			  39 01 00 00 00 00 02 2a 00 
			  39 01 00 00 00 00 02 2b 00 

			  39 01 00 00 00 00 02 31 07 
			  39 01 00 00 00 00 02 32 0c 
			  39 01 00 00 00 00 02 33 22 
			  39 01 00 00 00 00 02 34 23  
			  39 01 00 00 00 00 02 35 07 
			  39 01 00 00 00 00 02 36 08 
			  39 01 00 00 00 00 02 37 16 
			  39 01 00 00 00 00 02 38 14 
			  39 01 00 00 00 00 02 39 12 
			  39 01 00 00 00 00 02 3a 10 
			  39 01 00 00 00 00 02 3b 21 
			  39 01 00 00 00 00 02 3c 07  
			  39 01 00 00 00 00 02 3d 07 
			  39 01 00 00 00 00 02 3e 07 
			  39 01 00 00 00 00 02 3f 07 
			  39 01 00 00 00 00 02 40 07 
			  39 01 00 00 00 00 02 41 07 
			  39 01 00 00 00 00 02 42 07 
			  39 01 00 00 00 00 02 43 07 
			  39 01 00 00 00 00 02 44 07 
			  39 01 00 00 00 00 02 45 07 
			  39 01 00 00 00 00 02 46 07 
						                 
			  39 01 00 00 00 00 02 47 07 
			  39 01 00 00 00 00 02 48 0d 
			  39 01 00 00 00 00 02 49 22 
			  39 01 00 00 00 00 02 4a 23  
			  39 01 00 00 00 00 02 4b 07 
			  39 01 00 00 00 00 02 4c 09 
			  39 01 00 00 00 00 02 4d 17 
			  39 01 00 00 00 00 02 4e 15 
			  39 01 00 00 00 00 02 4f 13 
			  39 01 00 00 00 00 02 50 11 
			  39 01 00 00 00 00 02 51 21 
			  39 01 00 00 00 00 02 52 07  
			  39 01 00 00 00 00 02 53 07 
			  39 01 00 00 00 00 02 54 07 
			  39 01 00 00 00 00 02 55 07 
			  39 01 00 00 00 00 02 56 07 
			  39 01 00 00 00 00 02 57 07 
			  39 01 00 00 00 00 02 58 07 
			  39 01 00 00 00 00 02 59 07 
			  39 01 00 00 00 00 02 5a 07 
			  39 01 00 00 00 00 02 5b 07 
			  39 01 00 00 00 00 02 5c 07 
						              
			  39 01 00 00 00 00 02 61 07 
			  39 01 00 00 00 00 02 62 0d 
			  39 01 00 00 00 00 02 63 22 
			  39 01 00 00 00 00 02 64 23  
			  39 01 00 00 00 00 02 65 07 
			  39 01 00 00 00 00 02 66 09 
			  39 01 00 00 00 00 02 67 11 
			  39 01 00 00 00 00 02 68 13 
			  39 01 00 00 00 00 02 69 15 
			  39 01 00 00 00 00 02 6a 17 
			  39 01 00 00 00 00 02 6b 21 
			  39 01 00 00 00 00 02 6c 07  
			  39 01 00 00 00 00 02 6d 07 
			  39 01 00 00 00 00 02 6e 07 
			  39 01 00 00 00 00 02 6f 07 
			  39 01 00 00 00 00 02 70 07 
			  39 01 00 00 00 00 02 71 07 
			  39 01 00 00 00 00 02 72 07 
			  39 01 00 00 00 00 02 73 07 
			  39 01 00 00 00 00 02 74 07 
			  39 01 00 00 00 00 02 75 07 
			  39 01 00 00 00 00 02 76 07 
						               
			  39 01 00 00 00 00 02 77 07 
			  39 01 00 00 00 00 02 78 0c 
			  39 01 00 00 00 00 02 79 22 
			  39 01 00 00 00 00 02 7a 23  
			  39 01 00 00 00 00 02 7b 07 
			  39 01 00 00 00 00 02 7c 08 
			  39 01 00 00 00 00 02 7d 10 
			  39 01 00 00 00 00 02 7e 12 
			  39 01 00 00 00 00 02 7f 14 
			  39 01 00 00 00 00 02 80 16 
			  39 01 00 00 00 00 02 81 21 
			  39 01 00 00 00 00 02 82 07  
			  39 01 00 00 00 00 02 83 07 
			  39 01 00 00 00 00 02 84 07 
			  39 01 00 00 00 00 02 85 07 
			  39 01 00 00 00 00 02 86 07 
			  39 01 00 00 00 00 02 87 07 
			  39 01 00 00 00 00 02 88 07 
			  39 01 00 00 00 00 02 89 07 
			  39 01 00 00 00 00 02 8a 07 
			  39 01 00 00 00 00 02 8b 07 
			  39 01 00 00 00 00 02 8c 07 

			  39 01 00 00 00 00 02 b0 33 
			  39 01 00 00 00 00 02 ba 06 
			  39 01 00 00 00 00 02 c0 07 
			  39 01 00 00 00 00 02 c1 00 
			  39 01 00 00 00 00 02 c2 00 
			  39 01 00 00 00 00 02 c3 00 
			  39 01 00 00 00 00 02 c4 00 
			  39 01 00 00 00 00 02 ca 44 
						             
			  39 01 00 00 00 00 02 d0 01 
			  39 01 00 00 00 00 02 d1 22 
			  39 01 00 00 00 00 02 d3 40 
			  39 01 00 00 00 00 02 d5 51 
			  39 01 00 00 00 00 02 d6 20 
			  39 01 00 00 00 00 02 d7 01 
			  39 01 00 00 00 00 02 d8 00 
			  39 01 00 00 00 00 02 dc c2 
			  39 01 00 00 00 00 02 dd 10 
			  39 01 00 00 00 00 02 df b6 

			  39 01 00 00 00 00 02 e0 3E 
			  39 01 00 00 00 00 02 e2 47 
			  39 01 00 00 00 00 02 e7 54                                        
			  39 01 00 00 00 00 02 e6 22 
			  39 01 00 00 00 00 02 ee 15 

			  39 01 00 00 00 00 02 f1 00 
			  39 01 00 00 00 00 02 f2 00 
			  39 01 00 00 00 00 02 fa df 


			  39 01 00 00 00 00 04 FF 98 82 02 
			  39 01 00 00 00 00 02 F1 1C      
			  39 01 00 00 00 00 02 40 4B      
			  39 01 00 00 00 00 02 4B 5A      
			  39 01 00 00 00 00 02 50 CA      
			  39 01 00 00 00 00 02 51 50      
			  39 01 00 00 00 00 02 06 8D      
			  39 01 00 00 00 00 02 0B A0      
			  39 01 00 00 00 00 02 0C 80      
			  39 01 00 00 00 00 02 0D 1A      
			  39 01 00 00 00 00 02 0E 04      
			  39 01 00 00 00 00 02 4D CE      

			  39 01 00 00 00 00 02 73 04      
			  39 01 00 00 00 00 02 70 32 	  


			  39 01 00 00 00 00 04 FF 98 82 05 
			  39 01 00 00 00 00 02 A8 62 

			  39 01 00 00 00 00 02 63 73      
			  39 01 00 00 00 00 02 64 73      
			  39 01 00 00 00 00 02 68 65      
			  39 01 00 00 00 00 02 69 6B      
			  39 01 00 00 00 00 02 6A A1      
			  39 01 00 00 00 00 02 6B 93      
			  39 01 00 00 00 00 02 00 01      

			  39 01 00 00 00 00 02 46 00       
			  39 01 00 00 00 00 02 45 01      
			  39 01 00 00 00 00 02 17 50      
			  39 01 00 00 00 00 02 18 01      

			  39 01 00 00 00 00 02 85 37      
			  39 01 00 00 00 00 02 86 0F      


			  39 01 00 00 00 00 04 FF 98 82 06 
			  39 01 00 00 00 00 02 D9 1F      
			  39 01 00 00 00 00 02 C0 40      
			  39 01 00 00 00 00 02 C1 16      

			  39 01 00 00 00 00 02 07 F7      

			  39 01 00 00 00 00 02 D6 55 
			  39 01 00 00 00 00 02 DD 61 
			  39 01 00 00 00 00 02 DC 68

		 	  39 01 00 00 00 00 02 48 0F 
			  39 01 00 00 00 00 02 4D 80 
			  39 01 00 00 00 00 02 4E 40
			  39 01 00 00 00 00 02 C7 05	

			  39 01 00 00 00 00 04 FF 98 82 07 
			  39 01 00 00 00 00 02 00 0C      


			  39 01 00 00 00 00 04 FF 98 82 08 

			  39 01 00 00 00 00 1C E0 40 24 98 D1 10 55 40 64 8D AD A9 DF 05 25 45 AA 65 8D A7 CA FE E9 12 44 6B 03 EC 
			  39 01 00 00 00 00 1C E1 40 24 98 D1 10 55 40 64 8D AD A9 DF 05 25 45 AA 65 8D A7 CA FE E9 12 44 6B 03 EC 


			  39 01 00 00 00 00 04 FF 98 82 0B 
			  39 01 00 00 00 00 02 9A 44 
			  39 01 00 00 00 00 02 9B 88 
			  39 01 00 00 00 00 02 9C 03 
			  39 01 00 00 00 00 02 9D 03 
			  39 01 00 00 00 00 02 9E 71 
			  39 01 00 00 00 00 02 9F 71 
			  39 01 00 00 00 00 02 AB E0      

			  39 01 00 00 00 00 04 FF 98 82 0E 
			  39 01 00 00 00 00 02 02 09 
			  39 01 00 00 00 00 02 11 50 
			  39 01 00 00 00 00 02 13 10      
			  39 01 00 00 00 00 02 00 A0      

			  39 01 00 00 00 00 04 FF 98 82 00  
			 
			  39 01 00 00 00 00 02 51 7F
			  39 01 00 00 00 00 02 53 2C
			39 01 00 00 78 00 02 11 00
			39 01 00 00 14 00 02 29 00];
		qcom,mdss-dsi-off-command = [05 01 00 00 32 00 02 28 00
					05 01 00 00 78 00 02 10 00];
		qcom,mdss-dsi-on-command-state = "dsi_lp_mode";
		qcom,mdss-dsi-off-command-state = "dsi_lp_mode";
		qcom,mdss-dsi-panel-timings-phy-12nm = [08 06 09 02 00 04 02 08];
		qcom,mdss-dsi-h-sync-pulse = <0>;
		qcom,mdss-dsi-traffic-mode = "non_burst_sync_event";
		//qcom,mdss-dsi-traffic-mode = "burst_mode";
		qcom,mdss-dsi-lane-map = "lane_map_0123";
		qcom,mdss-dsi-bllp-eof-power-mode;
		qcom,mdss-dsi-bllp-power-mode;
		qcom,mdss-dsi-tx-eot-append;
		qcom,mdss-dsi-lane-0-state;
		qcom,mdss-dsi-lane-1-state;
		qcom,mdss-dsi-lane-2-state;
		qcom,mdss-dsi-lane-3-state;
		qcom,mdss-dsi-t-clk-post = <0x04>;
		qcom,mdss-dsi-t-clk-pre = <0x1b>;
		qcom,mdss-dsi-dma-trigger = "trigger_sw";
		qcom,mdss-dsi-mdp-trigger = "none";
		qcom,mdss-dsi-lp11-init;
		qcom,mdss-dsi-reset-sequence = <1 20>, <0 20>, <1 50>;
	};
};
